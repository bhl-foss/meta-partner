## conf/distro/include/distro-common.inc
```bitbake
# Common supported distro features
DISTRO_FEATURES:append = " \
    gobject-introspection-data \
    ipsec \
    ipv4 \
    ipv6 \
    ldconfig \
    overlayfs \
    seccomp \
    selinux \
    usbgadget \
    usbhost \
"
# directfb
# keyboard
# nfs
# smbfs
# xattr
# ld-is-gold
# lto
# ptest

# Common unsupported distro features
DISTRO_FEATURES:remove = " \
    3g \
    zeroconf \
"

# sota is logically a package management feature
IMAGE_FEATURES:remove:sota  = " package-management"

IMAGE_FEATURES:append = " package-management"
IMAGE_FEATURES:append = " debug-tweaks"

IMAGE_FSTYPES:remove = " ostreepush garagesign garagecheck"

PREFERRED_PROVIDER_virtual/runc = "runc-opencontainers"
PREFERRED_PROVIDER_virtual/containerd = "containerd-opencontainers"

OSTREE_RMDIR_HELPER_MSGTYPE = "bbwarn"
```

## conf/distro/include/image-license.inc
```bitbake
# Unwanted SPDX-License-Identifier GPL-3.0-or-later
INCOMPATIBLE_LICENSE:append = " AGPL-3.0* GPL-3.0* LGPL-3.0*"

# Unwanted identified packages allowed to build and generate QA warnings
INCOMPATIBLE_LICENSE_EXCEPTIONS:append = "\
    autoconf:GPL-3.0-or-later \
    bash:GPL-3.0-or-later \
    bc:GPL-3.0-or-later \
    binutils:GPL-3.0-or-later \
    bison:GPL-3.0-or-later \
    ccache:GPL-3.0-or-later \
    coreutils:GPL-3.0-or-later \
    coreutils-stdbuf:GPL-3.0-or-later \
    diffutils:GPL-3.0-or-later \
    elfutils:GPL-3.0-or-later \
    findutils:GPL-3.0-or-later \
    gawk:GPL-3.0-or-later \
    gdb:GPL-3.0-or-later \
    gdbm:GPL-3.0-or-later \
    gettext:GPL-3.0-or-later \
    gnutls:GPL-3.0-or-later \
    grep:GPL-3.0-or-later \
    libevent:GPL-3.0-or-later \
    libpipeline:GPL-3.0-or-later \
    libunistring:GPL-3.0-or-later \
    m4:GPL-3.0-or-later \
    make:GPL-3.0-or-later \
    readline:GPL-3.0-or-later \
    rsync:GPL-3.0-or-later \
    sed:GPL-3.0-or-later \
    which:GPL-3.0-or-later \
"
```

## conf/layer.conf
```bitbake
# We might have a conf and classes directory, append to BBPATH
BBPATH .= ":${LAYERDIR}"

# We have a recipes directory, add to BBFILES
BBFILES += "${LAYERDIR}/recipes*/*/*.bb ${LAYERDIR}/recipes*/*/*.bbappend"

BBFILE_COLLECTIONS += "partner-layer"
BBFILE_PATTERN_partner-layer := "^${LAYERDIR}/"
BBFILE_PRIORITY_partner-layer = "11"

LAYERDEPENDS_partner-layer = " \
  meta-lmp-base \
  meta-lmp-bsp \
  core \
  openembedded-layer \
  filesystems-layer \
  networking-layer \
  perl-layer \
  meta-python \
  virtualization-layer \
  sota \
  security \
"
LAYERSERIES_COMPAT_partner-layer = "kirkstone"

BBFILES_DYNAMIC += " \
  intel:${LAYERDIR}/dynamic-layers/intel/*/*/*.bb \
  intel:${LAYERDIR}/dynamic-layers/intel/*/*/*.bbappend \
  tegra:${LAYERDIR}/dynamic-layers/tegra/*/*/*.bb \
  tegra:${LAYERDIR}/dynamic-layers/tegra/*/*/*.bbappend \
  virtualization-layer:${LAYERDIR}/dynamic-layers/virtualization/*/*/*.bb \
  virtualization-layer:${LAYERDIR}/dynamic-layers/virtualization/*/*/*.bbappend \
"
```

## conf/machine/aaeon-boxer-6313.conf
```bitbake
# https://www.aaeon.com/en/p/bus-truck-box-computer-boxer-6313

MACHINE = "intel-corei7-64"
# MACHINEOVERRIDES =. "aaeon-boxer-6313:"

require conf/machine/intel-corei7-64.conf
require machine-common.inc

UEFI_SIGN_ENABLE = "1"

PREFERRED_PROVIDER_virtual/kernel = "linux-intel"
```

## conf/machine/aaeon-boxer-8250ai.conf
```bitbake
# https://www.aaeon.com/en/p/ai-edge-solutions-nvidia-jetson-xavier-nx-boxer-8250ai

MACHINEOVERRIDES =. "jetson-xavier-nx-devkit-emmc:"

require conf/machine/jetson-xavier-nx-devkit-emmc.conf

require conf/distro/include/distro-common.inc
require conf/machine/include/machine-common.inc

# UEFI_SIGN_ENABLE = "1"

PREFERRED_PROVIDER_virtual/kernel = "linux-tegra"

TNSPEC_BOOTDEV = "nvme0n1p1"
PARTITION_LAYOUT_EXTERNAL = "flash_l4t_external.xml"

# TEGRA_UEFI_DB_KEY = "${UEFI_SIGN_KEYDIR}/DB.key"
# TEGRA_UEFI_DB_CERT = "${UEFI_SIGN_KEYDIR}/DB.crt"
```

## conf/machine/aaeon-boxer-8622ai.conf
```bitbake
# https://www.aaeon.com/en/p/ai-edge-solutions-boxer-8622ai

MACHINEOVERRIDES =. "jetson-orin-nano-devkit-nvme:"

require conf/machine/jetson-orin-nano-devkit-nvme.conf

require conf/distro/include/distro-common.inc
require conf/machine/include/machine-common.inc

UEFI_SIGN_ENABLE = "1"

PREFERRED_PROVIDER_virtual/kernel = "linux-tegra"

TNSPEC_BOOTDEV = "nvme0n1p1"
PARTITION_LAYOUT_EXTERNAL = "flash_l4t_external.xml"

TEGRA_UEFI_DB_KEY = "${UEFI_SIGN_KEYDIR}/DB.key"
TEGRA_UEFI_DB_CERT = "${UEFI_SIGN_KEYDIR}/DB.crt"
```

## conf/machine/adlink-cexpress-bt.conf
```bitbake
# https://www.adlinktech.com/Products/Computer_on_Modules/COMExpressType6Compact/cExpress-BT

MACHINE = "intel-corei7-64"
# MACHINEOVERRIDES =. "adlink-cexpress-bt:"

require conf/machine/intel-corei7-64.conf
require machine-common.inc

UEFI_SIGN_ENABLE = "1"

PREFERRED_PROVIDER_virtual/kernel = "linux-intel"
```

## conf/machine/adlink-cexpress-sl.conf
```bitbake
# https://www.adlinktech.com/Products/Computer_on_Modules/COMExpressType6Compact/cExpress-SL

MACHINEOVERRIDES =. "intel-skylake-64:"

require conf/machine/include/meta-intel.inc
require conf/machine/include/x86/x86-base.inc
require conf/machine/include/tune-skylake.inc
require conf/machine/include/intel-common-pkgarch.inc

require conf/distro/include/distro-common.inc
require conf/machine/include/machine-common.inc

MACHINE_FEATURES:append = " intel-ucode"
MACHINE_FEATURES:append = " tpm tpm2"

MACHINE_HWCODECS ?= "intel-media-driver intel-mediasdk gstreamer1.0-vaapi"

# Enable optional dpdk:
COMPATIBLE_MACHINE:pn-dpdk = "intel-skylake-64"
COMPATIBLE_MACHINE:pn-dpdk-module = "intel-skylake-64"

XSERVER ?= "${XSERVER_X86_BASE} \
            ${XSERVER_X86_EXT} \
            ${XSERVER_X86_FBDEV} \
            ${XSERVER_X86_I915} \
            ${XSERVER_X86_I965} \
            ${XSERVER_X86_MODESETTING} \
            ${XSERVER_X86_VESA} \
            ${XSERVER_X86_ASPEED_AST} \
           "

SYSLINUX_OPTS = "serial 0 115200"
SERIAL_CONSOLES ?= "115200;ttyS0 115200;ttyS1 115200;ttyS2"
APPEND += "rootwait console=ttyS0,115200 console=tty0"

IMAGE_FSTYPES += "wic"
WKS_FILE ?= "${@bb.utils.contains_any("EFI_PROVIDER", "systemd-boot", "systemd-bootdisk-microcode.wks.in", "grub-bootdisk-microcode.wks.in", d)}"
WKS_FILE_DEPENDS:append = " intel-microcode"

# UEFI_SIGN_ENABLE = "1"

PREFERRED_PROVIDER_virtual/kernel = "linux-intel"
```

## conf/machine/include/machine-common.inc
```bitbake
# Common supported machine features
MACHINE_FEATURES:append = " \
    bluetooth \
    efi \
    keyboard \
    rtc \
    screen \
    serial \
    touchscreen \
    usbgadget \
    usbhost \
    wifi \
"

# Common unsupported machine features
MACHINE_FEATURES:remove = " \
    3g \
    pcbios \
    phone \
    pcmcia \
"
```

## conf/machine/machine-common.inc
```bitbake
PREFERRED_PROVIDER_virtual/runc = "runc-opencontainers"
PREFERRED_PROVIDER_virtual/containerd = "containerd-opencontainers"

DISTRO_FEATURES:append = " ld-is-gold lto ldconfig ptest"
DISTRO_FEATURES:append = " gobject-introspection-data"
DISTRO_FEATURES:append = " ipsec ipv4 ipv6"
DISTRO_FEATURES:append = " keyboard directfb"
DISTRO_FEATURES:append = " usbgadget usbhost"
DISTRO_FEATURES:append = " xattr"
DISTRO_FEATURES:append = " seccomp overlayfs nfs smbfs"

DISTRO_FEATURES:remove = " 3g zeroconf"

MACHINE_FEATURES:append = " efi"
MACHINE_FEATURES:append = " bluetooth wifi"
MACHINE_FEATURES:append = " keyboard screen touchscreen serial rtc"
MACHINE_FEATURES:append = " usbgadget usbhost"

MACHINE_FEATURES:remove = " 3g pcbios phone pcmcia"

KERNEL_MODULE_AUTOLOAD += "kernel-module-usb-wwan"
KERNEL_MODULE_AUTOLOAD += "kernel-module-qmi-wwan"
KERNEL_MODULE_AUTOLOAD += "kernel-module-qcserial"

EXTRA_IMAGE_FEATURES:append = " package-management"
EXTRA_IMAGE_FEATURES:append = " debug-tweaks"
```
